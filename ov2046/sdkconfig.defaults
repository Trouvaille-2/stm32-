## ov2046/sdkconfig.defaults
```kconfig
# ESP32-S3 CAM + OV2640 默认配置
# 芯片: ESP32-S3-N16R8（16MB Flash + 8MB Octal PSRAM）

# 目标芯片: ESP32-S3
CONFIG_IDF_TARGET="esp32s3"
CONFIG_IDF_TARGET_ESP32S3=y

# CPU 频率 240MHz
CONFIG_ESP_DEFAULT_CPU_FREQ_MHZ_240=y
CONFIG_ESP_DEFAULT_CPU_FREQ_MHZ=240

# === Flash 配置（N16R8 = 16MB Flash）===
CONFIG_ESPTOOLPY_FLASHSIZE_16MB=y
CONFIG_ESPTOOLPY_FLASHMODE_QIO=y
CONFIG_ESPTOOLPY_FLASHFREQ_80M=y

# === PSRAM 配置（N16R8 = 8MB Octal PSRAM）===
CONFIG_SPIRAM=y
CONFIG_SPIRAM_MODE_OCT=y             # Octal 模式（注意！不是 OCTAL）
CONFIG_SPIRAM_SPEED_80M=y            # Octal PSRAM 用 80MHz
CONFIG_SPIRAM_TYPE_AUTO=y
CONFIG_SPIRAM_ECC=y                  # 开启 ECC 更稳定
CONFIG_SPIRAM_ALLOW_BSS_SEG_EXTERNAL_MEMORY=n  # 不强制 BSS 段在 PSRAM
CONFIG_SPIRAM_IGNORE_NOTFOUND=n      # PSRAM 必须存在（N16R8 一定有）
CONFIG_SPIRAM_USE_CAPS_ALLOC=y

# === FreeRTOS ===
CONFIG_FREERTOS_HZ=1000

# === 日志等级 ===
CONFIG_LOG_DEFAULT_LEVEL_INFO=y
CONFIG_LOG_DEFAULT_LEVEL=3

# === 编译器优化 ===
CONFIG_COMPILER_OPTIMIZATION_PERF=y
```
